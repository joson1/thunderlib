## drivers/pwm/Kconfig
```kconfig
menu "pwm"

config PWM_EN
    bool "Enable pwm"
    default y
    help
        This option 
source "drivers/pwm/devices/Kconfig"

endmenu
```

## drivers/pwm/devices/Kconfig
```kconfig
menu "pwm devices"
depends on PWM_EN

config AXI_PWM
    bool "axi-pwm"
    depends on $(MARCH)="zynq7000"
    default n

endmenu
```

## drivers/sensors/Kconfig
```kconfig
config US015
    bool "us015"
    depends on $(MARCH)="zynq7000"
    default n
    help
        supersonic sensor
```

## drivers/timer/Kconfig
```kconfig
menu "timer"

config TIMER_EN
    bool "Enable timer"
    default y
    help
        This option 
source "drivers/timer/devices/Kconfig"

endmenu
```

## drivers/timer/devices/Kconfig
```kconfig
menu "timer devices"
depends on TIMER_EN

config TIMER_STM32F429
    bool "timer-stm32f429"
    depends on $(MARCH)="stm32f429"
    default n

config TIMER_ZYNQ7000
    bool "timer-zynq7000"
    depends on $(MARCH)="zynq7000"
    default n

endmenu
```

## drivers/tty/Kconfig
```kconfig
menu "tty"

config TTY_EN
    bool "Enable tty"
    depends on SERIAL_EN
    default y
    help
        This option 
# source "drivers/timer/devices/Kconfig"

endmenu
```

## drivers/video/Kconfig
```kconfig
menu "FrameBuffer"

config FB_EN
    bool "Enable FrameBuffer"
    default n
    help
        This option 
# source "drivers/timer/devices/Kconfig"

endmenu
```

## kernel/Kconfig
```kconfig
menu "kernel"

config KERNEL_EN
    bool "Enable MultiThread support"
    default n
    help
        This option 
source "kernel/platform/Kconfig"

endmenu
```

## kernel/platform/Kconfig
```kconfig
menu "kernel devices"
depends on KERNEL_EN

config KERNEL_STM32F429
    bool "interrupt-stm32f429"
    depends on $(MARCH)="stm32f429"
    default n
    

config KERNEL_ZYNQ7000
    bool "interrupt-zynq7000"
    depends on $(MARCH)="zynq7000"
    default n
    


config ZYNQ7000_CPUS
    depends on KERNEL_ZYNQ7000
	int "number of cpus 0f zynq7000"
	default 2


endmenu
```

## packages/Kconfig
```kconfig
menu "packages"


config GUI_EN
    bool "enable gui"
    help
        depends on Framebuffer


if GUI_EN
    source "packages/gui/Kconfig"
endif


endmenu
```

## packages/gui/Kconfig
```kconfig
menu "GUI"
depends on FB_EN


config GUI_LVGL
    bool "use lvgl"
    help
        use lvgl as gui

if GUI_LVGL
source "packages/gui/lvgl/Kconfig"
endif

config GUI_GUILITE
    bool "use guilite"
    help
        use guilite as gui


endmenu
```
