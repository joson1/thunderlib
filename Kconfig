## Kconfig
```kconfig
#
# For a description of the syntax of this configuration file,
# see Documentation/kbuild/kconfig-language.txt.
#
mainmenu "ThunderLib $(SDK_VERSION) Configuration for $(MARCH) ($(ARCH) $(CPU))"

menu "Build Config"

config CROSS_COMPILE
	string "Compiler"
	default "arm-none-eabi-"


endmenu

source "$(TOPDIR)/arch/$(ARCH)/$(CPU)/$(MARCH)/boards/Kconfig"
source "kernel/Kconfig"
source "drivers/Kconfig"
source "packages/gui/lvgl/Kconfig"
```

## arch/arm/cortex-a9/zynq7000/Kconfig
```kconfig
config LINK_RAM_BASE
	hex "ram base address"
	default 0x100000

config LINK_RAM_SIZE
    hex "ram size"
    default 0x1FF00000

config STACK_SIZE
    hex "stack size"
    default 0x80000

config HEAP_SIZE
    hex "heap size"
    default 0x200000
```

## arch/arm/cortex-a9/zynq7000/boards/Kconfig
```kconfig
choice BOARD_CHOICE
    bool "Board"
config MagicBox
    bool "MagicBox"
    help
        cpu:zynq7010

config Lite7020
    bool "Lite7020"
    help
        cpu:zynq7020



endchoice
```

## arch/arm/cortex-a9/zynq7000/configs/magicbox_defconfig
```kconfig
#
# Platform Config
#
CONFIG_CROSS_COMPILE="arm-none-eabi-"
# end of Platform Config

#
# Select Target Board
#
CONFIG_MagicBox=y
# CONFIG_Lite7020 is not set
# end of Select Target Board

#
# kernel
#
CONFIG_KERNEL_EN=y
# end of kernel

#
# drivers
#

#
# bus
#

#
# serial
#
CONFIG_SERIAL_EN=y

#
# devices
#
# CONFIG_SERIAL_STM32F429 is not set
CONFIG_SERIAL_ZYNQ=y
# end of devices
# end of serial

#
# i2c
#
CONFIG_I2C_EN=y

#
# devices
#
# CONFIG_I2C_STM32F429 is not set
CONFIG_I2C_ZYNQ=y
# end of devices
# end of i2c

#
# spi
#
CONFIG_SPI_EN=y

#
# devices
#
# CONFIG_SPI_STM32F429 is not set
CONFIG_SPI_ZYNQ=y
# end of devices
# end of spi
# end of bus

#
# dma
#
CONFIG_DMA_EN=y

#
# dma devices
#
# CONFIG_DMA_STM32F429 is not set
CONFIG_DMA_ZYNQ7000=y
# CONFIG_AXI_DMA is not set
# end of dma devices
# end of dma

#
# gpio
#
CONFIG_GPIO_EN=y

#
# gpio devices
#
# CONFIG_GPIO_STM32F429 is not set
CONFIG_GPIO_ZYNQ7000=y
# end of gpio devices
# end of gpio

#
# interrupt
#
CONFIG_INTERRUPT_EN=y

#
# interrupt devices
#
# CONFIG_INTERRUPT_STM32F429 is not set
CONFIG_INTERRUPT_ZYNQ7000=y
# end of interrupt devices
# end of interrupt

#
# timer
#
CONFIG_TIMER_EN=y

#
# timer devices
#
# CONFIG_TIMER_STM32F429 is not set
CONFIG_TIMER_ZYNQ7000=y
# end of timer devices
# end of timer

#
# pwm
#
CONFIG_PWM_EN=y

#
# interrupt devices
#
CONFIG_AXI_PWM=y
# end of interrupt devices
# end of pwm

#
# tty
#
CONFIG_TTY_EN=y
# end of tty
# end of drivers
```

## arch/arm/cortex-m4/stm32f429/Kconfig
```kconfig
config LINK_RAM_BASE
	hex "ram base address"
	default 0x20000000

config LINK_RAM_SIZE
    hex "ram size"
    default 0x30000

config STACK_SIZE
    hex "stack size"
    default 0x400

config HEAP_SIZE
    hex "heap size"
    default 0x2000
```

## arch/arm/cortex-m4/stm32f429/boards/Kconfig
```kconfig
choice BOARD_CHOICE
    bool "Board"
config ThunderBoards32
    bool "ThunderBoards32"
    help
        cpu:stm32f429



endchoice
```

## arch/arm/cortex-m4/stm32f429/configs/thunderboard32_defconfig
```kconfig
#
# Build Config
#
CONFIG_CROSS_COMPILE="arm-none-eabi-"
CONFIG_LINK_RAM_BASE=0XC0000000
CONFIG_LINK_RAM_SIZE=0x2000000
CONFIG_STACK_SIZE=0x400
CONFIG_HEAP_SIZE=0x2000
# end of Build Config

CONFIG_ThunderBoards32=y

#
# kernel
#
CONFIG_KERNEL_EN=y

#
# kernel devices
#
CONFIG_KERNEL_STM32F429=y
# end of kernel devices
# end of kernel

#
# drivers
#

#
# bus
#

#
# serial
#
CONFIG_SERIAL_EN=y

#
# devices
#
CONFIG_SERIAL_STM32F429=y
# end of devices
# end of serial

#
# i2c
#
CONFIG_I2C_EN=y

#
# devices
#
# CONFIG_I2C_STM32F429 is not set
CONFIG_SI2C_EN=y

#
# soft i2c based on gpio config
#
CONFIG_SOFT_I2C0_EN=y
CONFIG_SOFT_I2C0_ID=0
CONFIG_SOFT_I2C0_SCL=45
CONFIG_SOFT_I2C0_SDA=46
# end of soft i2c based on gpio config
# end of devices
# end of i2c

#
# spi
#
CONFIG_SPI_EN=y

#
# devices
#
CONFIG_SPI_STM32F429=y

#
# stm32f429-spi config
#
CONFIG_STM32_SPI1_EN=y
CONFIG_STM32_SPI2_EN=y
CONFIG_STM32_SPI3_EN=y
CONFIG_STM32_SPI4_EN=y
# end of stm32f429-spi config
# end of devices
# end of spi
# end of bus

#
# dma
#
CONFIG_DMA_EN=y

#
# dma devices
#
CONFIG_DMA_STM32F429=y
# end of dma devices
# end of dma

#
# gpio
#
CONFIG_GPIO_EN=y

#
# gpio devices
#
CONFIG_GPIO_STM32F429=y
# end of gpio devices
# end of gpio

#
# interrupt
#
CONFIG_INTERRUPT_EN=y

#
# interrupt devices
#
CONFIG_INTERRUPT_STM32F429=y
# end of interrupt devices
# end of interrupt

#
# timer
#
CONFIG_TIMER_EN=y

#
# timer devices
#
CONFIG_TIMER_STM32F429=y
# end of timer devices
# end of timer

#
# pwm
#
CONFIG_PWM_EN=y

#
# pwm devices
#
# end of pwm devices
# end of pwm

#
# tty
#
CONFIG_TTY_EN=y
# end of tty

#
# sensors
#
# end of sensors

#
# mtd
#
# CONFIG_AT24CXX is not set
CONFIG_SPI_FLASH=y
# end of mtd

#
# video
#

#
# FrameBuffer
#
CONFIG_FB_EN=y
# end of FrameBuffer
# end of video

#
# iio
#
# CONFIG_IIO_EN is not set
# end of iio
# end of drivers

#
# packages
#
# CONFIG_GUI_EN is not set
# end of packages
```

## drivers/Kconfig
```kconfig
menu "drivers"

source "drivers/bus/Kconfig"
source "drivers/dma/Kconfig"
source "drivers/gpio/Kconfig"
source "drivers/interrupt/Kconfig"
source "drivers/timer/Kconfig"
source "drivers/pwm/Kconfig"
source "drivers/tty/Kconfig"

menu "sensors"

source "drivers/sensors/Kconfig"

endmenu

source "drivers/mtd/Kconfig"

menu "video"
source "drivers/video/Kconfig"
endmenu

source "drivers/iio/Kconfig"
endmenu
```

## drivers/bus/Kconfig
```kconfig
menu "bus"

source "drivers/bus/serial/Kconfig"
source "drivers/bus/i2c/Kconfig"
source "drivers/bus/spi/Kconfig"


endmenu
```

## drivers/bus/i2c/Kconfig
```kconfig
menu "i2c"

config I2C_EN
    bool "Enable i2c"
    default y
    help
        This option 
source "drivers/bus/i2c/devices/Kconfig"
endmenu
```

## drivers/bus/i2c/devices/Kconfig
```kconfig
menu "devices"
depends on I2C_EN

config I2C_STM32F429
    bool "i2c-stm32f429"
    depends on $(MARCH)="stm32f429"
    default n

config SI2C_EN
    bool "soft i2c enable"
    depends on GPIO_EN

if SI2C_EN
    source "drivers/bus/i2c/devices/i2c-soft.config"
endif

config I2C_ZYNQ
    bool "i2c-zynq"
    depends on $(MARCH)="zynq7000"
    default n

if I2C_ZYNQ
    source "drivers/bus/i2c/devices/i2c-zynq.config"
endif

endmenu
```

## drivers/bus/serial/Kconfig
```kconfig
menu "serial"

config SERIAL_EN
    bool "Enable serial"
    default y
    help
        This option 
source "drivers/bus/serial/devices/Kconfig"
endmenu
```

## drivers/bus/serial/devices/Kconfig
```kconfig
menu "devices"
depends on SERIAL_EN

config SERIAL_STM32F429
    bool "serial-stm32f429"
    depends on $(MARCH)="stm32f429"
    default n

config SERIAL_ZYNQ
    bool "serial-zynq"
    depends on $(MARCH)="zynq7000"
    default n
    
endmenu
```

## drivers/bus/spi/Kconfig
```kconfig
menu "spi"

config SPI_EN
    bool "Enable spi"
    default y
    help
        This option 
source "drivers/bus/spi/devices/Kconfig"

endmenu
```

## drivers/bus/spi/devices/Kconfig
```kconfig
menu "devices"
depends on SPI_EN

config SPI_STM32F429
    bool "spi-stm32f429"
    depends on $(MARCH)="stm32f429"
    default n
    
if SPI_STM32F429
source "drivers/bus/spi/devices/spi-stm32f429.config"
endif
config SPI_ZYNQ
    bool "spi-zynq"
    depends on $(MARCH)="zynq7000"
    default n
    
    
endmenu
```

## drivers/dma/Kconfig
```kconfig
menu "dma"

config DMA_EN
    bool "Enable dma"
    default y
    help
        This option 
source "drivers/dma/devices/Kconfig"

endmenu
```

## drivers/dma/devices/Kconfig
```kconfig
menu "dma devices"

depends on DMA_EN


config DMA_ZYNQ7000
    bool "dma-zynq7000"
    depends on $(MARCH)="zynq7000"
    default y

config AXI_DMA
    bool "axi-dma"
    depends on $(MARCH)="zynq7000"
    default n




config DMA_STM32F429
    bool "dma-stm32f429"
    depends on $(MARCH)="stm32f429"


endmenu
```

## drivers/gpio/Kconfig
```kconfig
menu "gpio"

config GPIO_EN
    bool "Enable gpio"
    default y
    help
        This option 
source "drivers/gpio/devices/Kconfig"

endmenu
```

## drivers/gpio/devices/Kconfig
```kconfig
menu "gpio devices"
depends on GPIO_EN

config GPIO_STM32F429
    bool "gpio-stm32f429"
    depends on $(MARCH)="stm32f429"
    default n
    

config GPIO_ZYNQ7000
    bool "gpio-zynq7000"
    depends on $(MARCH)="zynq7000"
    default n
    

endmenu
```

## drivers/iio/Kconfig
```kconfig
menu "iio"

config IIO_EN
    bool "Enable iio devices"
    default n
    help
        ADI drivers


config IIO_AD9361
    bool "ad936x"
    depends on IIO_EN
    default n

endmenu
```

## drivers/interrupt/Kconfig
```kconfig
menu "interrupt"

config INTERRUPT_EN
    bool "Enable interrupt"
    default y
    help
        This option 
source "drivers/interrupt/devices/Kconfig"

endmenu
```

## drivers/interrupt/devices/Kconfig
```kconfig
menu "interrupt devices"
depends on INTERRUPT_EN

config INTERRUPT_STM32F429
    bool "interrupt-stm32f429"
    depends on $(MARCH)="stm32f429"
    default n
    

config INTERRUPT_ZYNQ7000
    bool "interrupt-zynq7000"
    depends on $(MARCH)="zynq7000"
    default n
    

endmenu
```

## drivers/mtd/Kconfig
```kconfig
menu "mtd"

config AT24CXX
    bool "at24cxx"
    depends on I2C_EN
    default n
    help
        supersonic sensor

config SPI_FLASH
    bool "spi-flash"
    depends on SPI_EN
    default n
    help
        supersonic sensor

endmenu
```

## drivers/pinmux/Kconfig
```kconfig
menu "pinmux"

config PINMUX_EN
    bool "Enable pinmux"
    default y
    help
        This option 
source "drivers/pinmux/devices/Kconfig"

endmenu
```

## drivers/pinmux/devices/Kconfig
```kconfig
menu "pin-mux devices"
depends on PINMUX_EN


config PIN_MUX_STM32F429
    bool "pinmux-stm32f429"
    depends on $(MARCH)="stm32f429"
    default y
    

endmenu
```
